// SPDX-License-Identifier: GPL-2.0
/dts-v1/;

#include <dt-bindings/interrupt-controller/mips-gic.h>
#include <dt-bindings/clock/intel,grx500-clk.h>

#include "xrx500-owrt.dtsi"

/ {
	compatible = "intel,easy550-2000-v2-anywan", "intel,xrx500";
	model = "Intel EASY550-2000 V2 ANYWAN (GRX550)";

	aliases {
		serial0 = &asc0;
	};

	chosen {
		bootargs = "earlycon=lantiq,0x16600000 clk_ignore_unused";
		stdout-path = "serial0";
	};

	memory@20000000 {
		device_type = "memory";
		reg = <0x20000000 0x0e000000>;
	};
};
